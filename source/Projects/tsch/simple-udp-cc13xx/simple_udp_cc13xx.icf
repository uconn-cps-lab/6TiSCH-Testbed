/*******************************************************************************
  Filename:       cc26xx_app.icf
  Revised:        $Date: 2014-03-19 11:10:17 -0700 (Wed, 19 Mar 2014) $
  Revision:       $Revision: 37793 $

  Description:    IAR ARM Linker Configuration File - TIMAC Application

  Imported Symbols
  Note: Linker defines are located in the IAR IDE project using --config_def
        in Options->Linker->Extra Options.

  CCxxxx:            Device Name (e.g. CC2650)

  Exported Symbols
  Note: Can be used as externs in C code.

  STACK_TOP: Location of the top of RAM.

  Copyright 2013-2014 Texas Instruments Incorporated. All rights reserved.

  IMPORTANT: Your use of this Software is limited to those specific rights
  granted under the terms of a software license agreement between the user
  who downloaded the software, his/her employer (which must be your employer)
  and Texas Instruments Incorporated (the "License").  You may not use this
  Software unless you agree to abide by the terms of the License. The License
  limits your use, and you acknowledge, that the Software may not be modified,
  copied or distributed unless embedded on a Texas Instruments microcontroller
  or used solely and exclusively in conjunction with a Texas Instruments radio
  frequency transceiver, which is integrated into your product.  Other than for
  the foregoing purpose, you may not use, reproduce, copy, prepare derivative
  works of, modify, distribute, perform, display or sell this Software and/or
  its documentation for any purpose.

  YOU FURTHER ACKNOWLEDGE AND AGREE THAT THE SOFTWARE AND DOCUMENTATION ARE
  PROVIDED “AS IS” WITHOUT WARRANTY OF ANY KIND, EITHER EXPRESS OR IMPLIED,
  INCLUDING WITHOUT LIMITATION, ANY WARRANTY OF MERCHANTABILITY, TITLE,
  NON-INFRINGEMENT AND FITNESS FOR A PARTICULAR PURPOSE. IN NO EVENT SHALL
  TEXAS INSTRUMENTS OR ITS LICENSORS BE LIABLE OR OBLIGATED UNDER CONTRACT,
  NEGLIGENCE, STRICT LIABILITY, CONTRIBUTION, BREACH OF WARRANTY, OR OTHER
  LEGAL EQUITABLE THEORY ANY DIRECT OR INDIRECT DAMAGES OR EXPENSES
  INCLUDING BUT NOT LIMITED TO ANY INCIDENTAL, SPECIAL, INDIRECT, PUNITIVE
  OR CONSEQUENTIAL DAMAGES, LOST PROFITS OR LOST DATA, COST OF PROCUREMENT
  OF SUBSTITUTE GOODS, TECHNOLOGY, SERVICES, OR ANY CLAIMS BY THIRD PARTIES
  (INCLUDING BUT NOT LIMITED TO ANY DEFENSE THEREOF), OR OTHER SIMILAR COSTS.

  Should you have any questions regarding your right to use this Software,
  contact Texas Instruments Incorporated at www.TI.com.
*******************************************************************************/

////////////////////////////////////////////////////////////////////////////////
// Memory Sizes
////////////////////////////////////////////////////////////////////////////////
define symbol RAM_SIZE            = 0x00005000;  // 20K
define symbol FLASH_SIZE          = 0x00020000;  // 128K
define symbol ROM_SIZE            = 0x0001C000;  // 115K

////////////////////////////////////////////////////////////////////////////////
// Memory Definitions
////////////////////////////////////////////////////////////////////////////////

////////////////////////////////////////////////////////////////////////////////
// RAM
//

define symbol RAM_START             = 0x20000000;
define symbol RAM_END               = 0x20004FE0;

////////////////////////////////////////////////////////////////////////////////
// CACHE RAM
//

define symbol CACHE_RAM_START             = 0x11000000;
define symbol CACHE_RAM_END               = 0x11001FFF;

////////////////////////////////////////////////////////////////////////////////
// Flash
//

define symbol FLASH_START           = 0x00000000;
define symbol FLASH_END             = 0x0001FFFF; //0x00007FFF


////////////////////////////////////////////////////////////////////////////////
// Stack
//

define symbol STACK_SIZE           = 0x500;
define symbol STACK_START          = RAM_END + 1;
define symbol STACK_END            = STACK_START - STACK_SIZE;
define block CSTACK with alignment = 8, size = STACK_SIZE { section .stack };
//
define symbol STACK_TOP            = RAM_END + 1;
export symbol STACK_TOP;

////////////////////////////////////////////////////////////////////////////////
// Heap
//

define symbol HEAP_SIZE            = 0x500; 
define block  HEAP with alignment  = 8, size = HEAP_SIZE { };

////////////////////////////////////////////////////////////////////////////////
// Flash Interrupt Vector Table
//

define symbol INTVEC_NUM_ENTRIES   = 50 + 1; // first entry is stack location
define symbol INTVEC_SIZE          = INTVEC_NUM_ENTRIES + 4;

////////////////////////////////////////////////////////////////////////////////
// Customer Configuration Area (CCA)
//

define symbol CCA_NUM_ENTRIES      = 20;
define symbol CCA_SIZE             = (CCA_NUM_ENTRIES * 4);
define symbol CCA_START            = (FLASH_SIZE-1) - CCA_SIZE + 1;
define symbol CCA_END              = (FLASH_SIZE-1);

////////////////////////////////////////////////////////////////////////////////
// Memory Regions
////////////////////////////////////////////////////////////////////////////////

define memory mem with size = 4G;

define region RAM        = mem:[from RAM_START   to RAM_END];
define region FLASH      = mem:[from FLASH_START to FLASH_END];
define region FLASH_CCA  = mem:[from CCA_START   to CCA_END];
define region CACHE_RAM  = mem:[from CACHE_RAM_START   to CACHE_RAM_END];

////////////////////////////////////////////////////////////////////////////////
// Memory Placement
////////////////////////////////////////////////////////////////////////////////

// CCA
//place at start of FLASH_CCA { readonly section .ccfg };
place at end of FLASH { readonly section .ccfg };
keep                        { readonly section .ccfg};

// Interrupt Vector Table
place at address mem:FLASH_START { readonly section .intvec };
keep                             { readonly section .intvec };

// RAM Vector Table
place at start of RAM { section .vtable_ram };

// Stack
place at end of RAM { block CSTACK };

// Heap
place in RAM { block HEAP };

place in FLASH { readonly };
place in RAM   { readwrite };


place in CACHE_RAM { rw object nhldb-tsch-sched.o,
                     rw object nhldb-tsch-cmm.o,
                     rw object nhl_device_table.o,
                     rw object queuebuf.o,
                     rw object uip-ds6.o,
                     rw object uip-ds6-route.o,
                     rw object uip-ds6-nbr.o,
                     rw object rpl-dag.o,
                     rw object sicslowpan.o
                    };

////////////////////////////////////////////////////////////////////////////////
// Initialization
////////////////////////////////////////////////////////////////////////////////

initialize by copy { readwrite };

do not initialize
{
  section .noinit,
  section .stack,
};

////////////////////////////////////////////////////////////////////////////////

if ( isdefinedsymbol(USE_SYSBIOS_IN_ROM) )
{
place at address mem:0x00001490 {readonly section .const_xdc_runtime_Error_policy__C};
place at address mem:0x0000143c {readonly section .const_xdc_runtime_IModule_Interface__BASE__C};
place at address mem:0x00001420 {readonly section .const_xdc_runtime_Startup_lastFxns__C};
place at address mem:0x00001210 {readonly section .const_ti_sysbios_gates_GateMutex_Object__DESC__C};
place at address mem:0x000014b0 {readonly section .const_ti_sysbios_rom_ROM_ti_sysbios_family_arm_cc26xx_Timer_initDevice__I};
place at address mem:0x00001450 {readonly section .const_xdc_runtime_Startup_execImpl__C};
place at address mem:0x000014d0 {readonly section .const_ti_sysbios_gates_GateMutex_Instance_State_sem__O};
place at address mem:0x000014ac {readonly section .const_ti_sysbios_rom_ROM_ti_sysbios_family_arm_cc26xx_Timer_getMaxTicks__E};
place at address mem:0x000013e0 {readonly section .const_ti_sysbios_knl_Swi_Object__count__C};
place at address mem:0x00001378 {readonly section .const_ti_sysbios_knl_Idle_funcList__C};
place at address mem:0x00001070 {readonly section .const_ti_sysbios_family_arm_m3_Hwi_Object__PARAMS__C};
place at address mem:0x0000148e {readonly section .const_xdc_runtime_Text_isLoaded__C};
place at address mem:0x00001270 {readonly section .const_ti_sysbios_knl_Clock_Object__DESC__C};
place at address mem:0x00001380 {readonly section .const_ti_sysbios_family_arm_cc26xx_Boot_alternateBackdoorIOID__C};
place at address mem:0x000014d8 {readonly section .const_ti_sysbios_knl_Mailbox_Instance_State_dataQue__O};
place at address mem:0x00001140 {readonly section .const_ti_sysbios_gates_GateMutex_Module__FXNS__C};
place at address mem:0x000014ec {readonly section .const_ti_sysbios_knl_Task_Module_State_inactiveQ__O};
place at address mem:0x0000140a {readonly section .const_ti_sysbios_family_arm_m3_Hwi_Module__id__C};
place at address mem:0x00001406 {readonly section .const_ti_sysbios_family_arm_cc26xx_Timer_Module__id__C};
place at address mem:0x000013d0 {readonly section .const_ti_sysbios_knl_Mailbox_Object__table__C};
place at address mem:0x00001398 {readonly section .const_ti_sysbios_family_arm_m3_Hwi_Object__table__C};
place at address mem:0x000012f0 {readonly section .const_ti_sysbios_knl_Swi_Object__DESC__C};
place at address mem:0x0000148c {readonly section .const_xdc_runtime_Text_charCnt__C};
place at address mem:0x000014bc {readonly section .const_ti_sysbios_rom_ROM_ti_sysbios_family_arm_cc26xx_Timer_start__E};
place at address mem:0x000013c0 {readonly section .const_ti_sysbios_heaps_HeapMem_Object__table__C};
place at address mem:0x00001430 {readonly section .const_xdc_runtime_Error_policyFxn__C};
place at address mem:0x000014a4 {readonly section .const_ti_sysbios_rom_ROM_ti_sysbios_family_arm_cc26xx_Timer_getCount64__E};
place at address mem:0x00001418 {readonly section .const_xdc_runtime_Startup_firstFxns__C};
place at address mem:0x000010f4 {readonly section .const_ti_sysbios_knl_Swi_Object__PARAMS__C};
place at address mem:0x000013c8 {readonly section .const_ti_sysbios_knl_Clock_serviceMargin__C};
place at address mem:0x00001478 {readonly section .const_xdc_runtime_Text_charTab__C};
place at address mem:0x0000149c {readonly section .const_ti_sysbios_rom_ROM_AONRTCCurrentCompareValueGet};
place at address mem:0x000014c0 {readonly section .const_ti_sysbios_rom_ROM_ti_sysbios_family_arm_cc26xx_TimestampProvider_get32__E};
place at address mem:0x000014a8 {readonly section .const_ti_sysbios_rom_ROM_ti_sysbios_family_arm_cc26xx_Timer_getCurrentTick__E};
place at address mem:0x000013b0 {readonly section .const_ti_sysbios_family_arm_m3_TaskSupport_stackAlignment__C};
place at address mem:0x00001390 {readonly section .const_ti_sysbios_family_arm_m3_Hwi_NUM_INTERRUPTS__C};
place at address mem:0x00001448 {readonly section .const_xdc_runtime_Main_Module__diagsMask__C};
place at address mem:0x000013e4 {readonly section .const_ti_sysbios_knl_Swi_Object__table__C};
place at address mem:0x00001404 {readonly section .const_ti_sysbios_family_arm_cc26xx_Boot_overrideDefaultBackdoorIOID__C};
place at address mem:0x0000148a {readonly section .const_xdc_runtime_Memory_Module__id__C};
place at address mem:0x00001000 {readonly section .const_ti_sysbios_knl_Task_Object__PARAMS__C};
place at address mem:0x00001348 {readonly section .const_ti_sysbios_gates_GateMutex_Object__PARAMS__C};
place at address mem:0x000013b8 {readonly section .const_ti_sysbios_heaps_HeapMem_Module__gateObj__C};
place at address mem:0x00001384 {readonly section .const_ti_sysbios_family_arm_cc26xx_Timer_startupNeeded__C};
place at address mem:0x000012b0 {readonly section .const_ti_sysbios_knl_Queue_Object__DESC__C};
place at address mem:0x00001310 {readonly section .const_ti_sysbios_knl_Task_Object__DESC__C};
place at address mem:0x00001428 {readonly section .const_xdc_runtime_Assert_E_assertFailed__C};
place at address mem:0x00001164 {readonly section .const_ti_sysbios_heaps_HeapMem_Object__PARAMS__C};
place at address mem:0x0000140c {readonly section .const_ti_sysbios_gates_GateHwi_Module__id__C};
place at address mem:0x00001330 {readonly section .const_ti_sysbios_gates_GateHwi_Object__PARAMS__C};
place at address mem:0x00001438 {readonly section .const_xdc_runtime_IHeap_Interface__BASE__C};
place at address mem:0x00001468 {readonly section .const_xdc_runtime_SysCallback_exitFxn__C};
place at address mem:0x00001410 {readonly section .const_ti_sysbios_heaps_HeapMem_Module__id__C};
place at address mem:0x000013a0 {readonly section .const_ti_sysbios_family_arm_m3_Hwi_excHandlerFunc__C};
place at address mem:0x000010cc {readonly section .const_ti_sysbios_heaps_HeapMem_Module__FXNS__C};
place at address mem:0x00001474 {readonly section .const_xdc_runtime_System_maxAtexitHandlers__C};
place at address mem:0x000013d8 {readonly section .const_ti_sysbios_knl_Queue_Object__count__C};
place at address mem:0x000013f0 {readonly section .const_ti_sysbios_knl_Task_Object__table__C};
place at address mem:0x00001290 {readonly section .const_ti_sysbios_knl_Mailbox_Object__DESC__C};
place at address mem:0x000013a4 {readonly section .const_ti_sysbios_family_arm_m3_Hwi_nullIsrFunc__C};
place at address mem:0x00001414 {readonly section .const_ti_sysbios_knl_Clock_tickMode__C};
place at address mem:0x0000140e {readonly section .const_ti_sysbios_gates_GateMutex_Module__id__C};
place at address mem:0x000013e8 {readonly section .const_ti_sysbios_knl_Swi_numPriorities__C};
place at address mem:0x00001400 {readonly section .const_ti_sysbios_knl_Task_numConstructedTasks__C};
place at address mem:0x00001454 {readonly section .const_xdc_runtime_Startup_maxPasses__C};
place at address mem:0x000014a0 {readonly section .const_ti_sysbios_rom_ROM_AONRTCEventClear};
place at address mem:0x00001412 {readonly section .const_ti_sysbios_knl_Task_initStackFlag__C};
place at address mem:0x00001440 {readonly section .const_xdc_runtime_Main_Module__diagsEnabled__C};
place at address mem:0x00001444 {readonly section .const_xdc_runtime_Main_Module__diagsIncluded__C};
place at address mem:0x0000146c {readonly section .const_xdc_runtime_System_abortFxn__C};
place at address mem:0x000014dc {readonly section .const_ti_sysbios_knl_Mailbox_Instance_State_dataSem__O};
place at address mem:0x0000111c {readonly section .const_ti_sysbios_gates_GateHwi_Module__FXNS__C};
place at address mem:0x00001230 {readonly section .const_ti_sysbios_hal_Hwi_Object__DESC__C};
place at address mem:0x000013ac {readonly section .const_ti_sysbios_family_arm_m3_Hwi_priGroup__C};
place at address mem:0x0000142c {readonly section .const_xdc_runtime_Error_E_memory__C};
place at address mem:0x00001388 {readonly section .const_ti_sysbios_family_arm_m3_Hwi_E_alreadyDefined__C};
place at address mem:0x000014e4 {readonly section .const_ti_sysbios_knl_Mailbox_Instance_State_freeSem__O};
place at address mem:0x000013dc {readonly section .const_ti_sysbios_knl_Queue_Object__table__C};
place at address mem:0x000011ac {readonly section .const_ti_sysbios_knl_Semaphore_Object__PARAMS__C};
place at address mem:0x00001470 {readonly section .const_xdc_runtime_System_exitFxn__C};
place at address mem:0x00001188 {readonly section .const_ti_sysbios_knl_Clock_Object__PARAMS__C};
place at address mem:0x00001498 {readonly section .const_ti_sysbios_rom_ROM_AONRTCCompareValueSet};
place at address mem:0x000014b4 {readonly section .const_ti_sysbios_rom_ROM_ti_sysbios_family_arm_cc26xx_Timer_setNextTick__E};
place at address mem:0x000013c4 {readonly section .const_ti_sysbios_heaps_HeapMem_reqAlign__C};
place at address mem:0x00001488 {readonly section .const_xdc_runtime_Main_Module__id__C};
place at address mem:0x00001458 {readonly section .const_xdc_runtime_Startup_sfxnRts__C};
place at address mem:0x000012d0 {readonly section .const_ti_sysbios_knl_Semaphore_Object__DESC__C};
place at address mem:0x000011f0 {readonly section .const_ti_sysbios_gates_GateHwi_Object__DESC__C};
place at address mem:0x000013bc {readonly section .const_ti_sysbios_heaps_HeapMem_Object__count__C};
place at address mem:0x000013a8 {readonly section .const_ti_sysbios_family_arm_m3_Hwi_numSparseInterrupts__C};
place at address mem:0x000013d4 {readonly section .const_ti_sysbios_knl_Mailbox_maxTypeAlign__C};
place at address mem:0x00001408 {readonly section .const_ti_sysbios_family_arm_cc26xx_TimestampProvider_useClockTimer__C};
place at address mem:0x000014cc {readonly section .const_ti_sysbios_rom_ROM_xdc_runtime_System_SupportProxy_exit__E};
place at address mem:0x00001360 {readonly section .const_ti_sysbios_knl_Queue_Object__PARAMS__C};
place at address mem:0x000013f4 {readonly section .const_ti_sysbios_knl_Task_allBlockedFunc__C};
place at address mem:0x000014c8 {readonly section .const_ti_sysbios_rom_ROM_xdc_runtime_System_SupportProxy_abort__E};
place at address mem:0x000013cc {readonly section .const_ti_sysbios_knl_Mailbox_Object__count__C};
place at address mem:0x00001480 {readonly section .const_xdc_runtime_Text_nameStatic__C};
place at address mem:0x000014c4 {readonly section .const_ti_sysbios_rom_ROM_xdc_runtime_Startup_getState__I};
place at address mem:0x000014d4 {readonly section .const_ti_sysbios_knl_Clock_Module_State_clockQ__O};
place at address mem:0x000013fc {readonly section .const_ti_sysbios_knl_Task_defaultStackSize__C};
place at address mem:0x00001434 {readonly section .const_xdc_runtime_IGateProvider_Interface__BASE__C};
place at address mem:0x0000138c {readonly section .const_ti_sysbios_family_arm_m3_Hwi_E_hwiLimitExceeded__C};
place at address mem:0x00001460 {readonly section .const_xdc_runtime_Startup_startModsFxn__C};
place at address mem:0x000014e8 {readonly section .const_ti_sysbios_knl_Semaphore_Instance_State_pendQ__O};
place at address mem:0x000011d0 {readonly section .const_ti_sysbios_family_arm_m3_Hwi_Object__DESC__C};
place at address mem:0x0000147c {readonly section .const_xdc_runtime_Text_nameEmpty__C};
place at address mem:0x00001394 {readonly section .const_ti_sysbios_family_arm_m3_Hwi_Object__count__C};
place at address mem:0x00001464 {readonly section .const_xdc_runtime_SysCallback_abortFxn__C};
place at address mem:0x000013f8 {readonly section .const_ti_sysbios_knl_Task_defaultStackHeap__C};
place at address mem:0x0000139c {readonly section .const_ti_sysbios_family_arm_m3_Hwi_ccr__C};
place at address mem:0x0000103c {readonly section .const_ti_sysbios_knl_Mailbox_Object__PARAMS__C};
place at address mem:0x000010a0 {readonly section .const_ti_sysbios_hal_Hwi_Object__PARAMS__C};
place at address mem:0x000013b4 {readonly section .const_ti_sysbios_heaps_HeapMem_E_memory__C};
place at address mem:0x000013ec {readonly section .const_ti_sysbios_knl_Task_Object__count__C};
place at address mem:0x00001494 {readonly section .const_ti_sysbios_rom_ROM_AONRTCChannelEnable};
place at address mem:0x00001250 {readonly section .const_ti_sysbios_heaps_HeapMem_Object__DESC__C};
place at address mem:0x00001484 {readonly section .const_xdc_runtime_Text_nameUnknown__C};
place at address mem:0x0000144c {readonly section .const_xdc_runtime_Memory_defaultHeapInstance__C};
place at address mem:0x000014e0 {readonly section .const_ti_sysbios_knl_Mailbox_Instance_State_freeQue__O};
place at address mem:0x000014b8 {readonly section .const_ti_sysbios_rom_ROM_ti_sysbios_family_arm_cc26xx_Timer_setThreshold__I};
place at address mem:0x0000145c {readonly section .const_xdc_runtime_Startup_sfxnTab__C};
place at address mem:0x20000178 {readwrite section .data_ti_sysbios_knl_Clock_Module__state__V};
place at address mem:0x200001ec {readwrite section .data_ti_sysbios_family_arm_cc26xx_TimestampProvider_Module__state__V};
place at address mem:0x200001f0 {readwrite section .data_xdc_runtime_Startup_Module__state__V};
place at address mem:0x200001a4 {readwrite section .data_ti_sysbios_BIOS_Module__state__V};
place at address mem:0x200001c8 {readwrite section .data_ti_sysbios_knl_Swi_Module__state__V};
place at address mem:0x20000100 {readwrite section .data_ti_sysbios_knl_Task_Module__state__V};
place at address mem:0x20000200 {readwrite section .data_xdc_runtime_Memory_Module__state__V};
place at address mem:0x200001f8 {readwrite section .data_xdc_runtime_System_Module__state__V};
place at address mem:0x20000144 {readwrite section .data_ti_sysbios_family_arm_m3_Hwi_Module__state__V};
place at address mem:0x200001e4 {readwrite section .data_ti_sysbios_family_arm_cc26xx_Timer_Module__state__V};
}
